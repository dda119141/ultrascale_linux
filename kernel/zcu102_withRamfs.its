## kernel/zcu102_withRamfs.its
```
/dts-v1/;
/ {
    description = "U-Boot fitImage for plnx_aarch64 kernel";
    #address-cells = <1>;
    images {
        kernel-0 {
            description = "Linux Kernel";
            data = /incbin/("Image");
            type = "kernel";
            arch = "arm64";
            os = "linux";
            compression = "none";
            load = <0x200000>;
            entry = <0x200000>;
            hash-1 {
                algo = "sha1";
            };
        };
        fdt-0 {
            description = "Flattened Device Tree blob";
            data = /incbin/("system.dtb");
            type = "flat_dt";
            arch = "arm64";
            compression = "none";
            hash-1 {
                algo = "sha1";
            };
        };
        initramfs-0 {
            description = "Init Ram FS";
            data = /incbin/("initramfs.cpio.gz");
            type = "ramdisk";
            arch = "arm64";
						os = "linux";
            compression = "none";
            hash-1 {
                algo = "sha1";
            };
        };
 
    };

configurations {
    default = "conf-1";
    conf-1 {
        description = "Boot Linux kernel with FDT blob and ramdisk";
        kernel = "kernel-0";
        fdt = "fdt-0";
				ramdisk = "initramfs-0";
        hash-1 {
            algo = "sha1";
        };
    };
    };
};
```
